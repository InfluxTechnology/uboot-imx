## board/influxtechnology/common/Kconfig
```kconfig
config INF_NO_UART_FLUSH
	bool "Disable flush of UART at boot"
	default n

config INF_IMX_PTP
	bool "Enable when using Influx Technology test platform"
	default n
	help
	  Enable this option when building a u-boot for the Influx Technology
	  test platform
```

## board/influxtechnology/mx8mm-influx-rex-smart/Kconfig
```kconfig
if TARGET_MX8MM_INFLUX

config SYS_BOARD
	default "mx8mm-influx-rex-smart"

config SYS_VENDOR
	default "influxtechnology"

config SYS_CONFIG_NAME
	default "mx8mm-influx-rex-smart"

config IMX_CONFIG
	default "board/influxtechnology/mx8mm-influx-rex-smart/imximage-8mm-lpddr4.cfg"

endif
```

## board/influxtechnology/mx8mn-influx-rex-smart/Kconfig
```kconfig
if TARGET_MX8MNEA_UCOM

config SYS_BOARD
	default "mx8mn-influx-rex-smart"

config SYS_VENDOR
	default "influxtechnology"

config SYS_CONFIG_NAME
	default "mx8mn-influx-rex-smart"

config IMX_CONFIG
	default "board/influxtechnology/mx8mn-influx-rex-smart/imximage-8mn-ddr4.cfg"

endif
```
